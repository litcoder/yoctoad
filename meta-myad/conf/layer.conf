## meta-myad/conf/layer.conf
```bitbake
BBPATH .= ":${LAYERDIR}"
BBFILES += "${LAYERDIR}/recipes-*/*/*.bb \
            ${LAYERDIR}/recipes-*/*/*.bbappend"

BBFILE_COLLECTIONS += "myad"
LAYERSERIES_COMPAT_myad = "kirkstone scarthgap"
BBFILE_PATTERN_myad = "^${LAYERDIR}/"
BBFILE_PRIORITY_myad = "6"
```

## meta-reaction-game/conf/layer.conf
```bitbake
BBPATH .= ":${LAYERDIR}"
BBFILES += "${LAYERDIR}/recipes-*/*/*.bb \
            ${LAYERDIR}/recipes-*/*/*.bbappend"

BBFILE_COLLECTIONS += "reaction-game"
BBFILE_PATTERN_reaction-game = "^${LAYERDIR}/"
BBFILE_PRIORITY_reaction-game = "6"
```
